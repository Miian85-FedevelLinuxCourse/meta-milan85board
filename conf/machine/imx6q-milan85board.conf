## conf/machine/imx6q-milan85board.conf
```bitbake
#@TYPE: Machine
#@NAME: FEDEVEL Linux course - milan85board
#@SOC: i.MX6Q
#@DESCRIPTION: Machine configuration for FEDEVEL Linux course milan85board
#@MAINTAINER: Milan Milanovic <milan1808@hotmail.com>

require conf/machine/include/imx6milan85board-common.inc

SOC_FAMILY = "mx6:mx6q"

PREFERRED_PROVIDER_u-boot_mx6 = "u-boot-milan85board"
PREFERRED_PROVIDER_virtual/kernel_mx6 = "linux-milan85board"
PREFERRED_VERSION_linux-milan85board ?= "3.14"

KERNEL_DEVICETREE = "imx6q-milan85board.dtb"

UBOOT_CONFIG ??= "sd"
UBOOT_CONFIG[sd] = "mx6qmilan85board_config,sdcard"
UBOOT_CONFIG[mfgtool] = "mx6qmilan85board_config"
```
